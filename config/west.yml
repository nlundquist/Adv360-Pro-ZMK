## config/west.yml
```yaml
manifest:
  remotes:
    - name: zmkfirmware
      url-base: https://github.com/zmkfirmware
    - name: refil
      url-base: https://github.com/refil
    - name: nlundquist
      url-base: https://github.com/nlundquist
  projects:
    - name: zmk
      remote: refil
      revision: adv360-z3.5-2
      import: app/west.yml
    - name: zmk-listeners
      remote: nlundquist
      revision: add-hid-listener
  self:
    path: config
```
